#include <dt-bindings/zmk/mouse.h>

&mmv {
  acceleration-exponent = <1>;      // 1
  time-to-max-speed-ms = <1000>;    // 40
  delay-ms = <0>;                   // 0
};

&mwh {
  acceleration-exponent = <1>;      // 0
  time-to-max-speed-ms = <0>;       // 40
  delay-ms = <0>;                   // 10
};

#define U_MOUSE_MOVE_MAX 3000       // 600
#define U_MOUSE_SCROLL_MAX 50       // 10

#undef MOVE_UP
#undef MOVE_DOWN
#undef MOVE_LEFT
#undef MOVE_RIGHT
#define MOVE_UP MOVE_VERT(-U_MOUSE_MOVE_MAX)
#define MOVE_DOWN MOVE_VERT(U_MOUSE_MOVE_MAX)
#define MOVE_LEFT MOVE_HOR(-U_MOUSE_MOVE_MAX)
#define MOVE_RIGHT MOVE_HOR(U_MOUSE_MOVE_MAX)

#undef SCROLL_UP
#undef SCROLL_DOWN
#undef SCROLL_LEFT
#undef SCROLL_RIGHT
#define SCROLL_UP SCROLL_VERT(U_MOUSE_SCROLL_MAX)
#define SCROLL_DOWN SCROLL_VERT(-U_MOUSE_SCROLL_MAX)
#define SCROLL_LEFT SCROLL_HOR(-U_MOUSE_SCROLL_MAX)
#define SCROLL_RIGHT SCROLL_HOR(U_MOUSE_SCROLL_MAX)

/ {
  #define MACRO_SYMBOL(NAME, SYMBOLS) \
    NAME: NAME { \
      compatible = "zmk,behavior-macro"; \
      label = ZMK_MACRO_STRINGIFY(NAME); \
      #binding-cells = <0>; \
      wait-ms = <10>; \
      tap-ms = <10>; \
      bindings = <&macro_tap SYMBOLS>; \
    };

  #define TAPDANCE_SYMBOL(NAME, TAPHOLD, DTAP, TTAP) \
    NAME: NAME { \
      compatible = "zmk,behavior-tap-dance"; \
      label = ZMK_MACRO_STRINGIFY(NAME); \
      #binding-cells = <0>; \
      tapping-term-ms = <200>; \
      bindings = <TAPHOLD>, <DTAP>, <TTAP>; \
    };

  #define TURBO_SYMBOL(NAME, BINDINGS, WAIT_MS) \
    NAME: NAME { \
      compatible = "zmk,behavior-turbo-key"; \
      label = ZMK_MACRO_STRINGIFY(NAME); \
      #binding-cells = <0>; \
      wait-ms = <WAIT_MS>; \
      bindings = <BINDINGS>; \
    };
    // toggle-term-ms = <50>; \

  MACRO_SYMBOL(mc_lclick, &mkp MB1)
  TURBO_SYMBOL(tu_lclick, &mc_lclick, 35)
  TAPDANCE_SYMBOL(td_lclick, &mkp MB1, &tu_lclick, &none)
};

#define U_BTN1 &td_lclick
#define U_BTN2 &mkp MB2
#define U_BTN3 &mkp MB3
#define U_MS_U &mmv MOVE_UP
#define U_MS_D &mmv MOVE_DOWN
#define U_MS_L &mmv MOVE_LEFT
#define U_MS_R &mmv MOVE_RIGHT
#define U_WH_U &mwh SCROLL_UP
#define U_WH_D &mwh SCROLL_DOWN
#define U_WH_L &mwh SCROLL_LEFT
#define U_WH_R &mwh SCROLL_RIGHT
