/*                KEY POSITIONS
  ╭─────────────────────╮ ╭─────────────────────╮
  │ LT4 LT3 LT2 LT1 LT0 │ │ RT0 RT1 RT2 RT3 RT4 │
  │ LM4 LM3 LM2 LM1 LM0 │ │ RM0 RM1 RM2 RM3 RM4 │
  │ LB4 LB3 LB2 LB1 LB0 │ │ RB0 RB1 RB2 RB3 RB4 │
  ╰───────────╮ TL1 TL0 │ │ TR0 TR1 ╭───────────╯
              ╰─────────╯ ╰─────────╯            */

/ {
  behaviors {

    //NOTE: HOMEROW
    HOLD_TAP(hrml, "balanced", 280, (-1), 150, &kp, &kp, <KEYS_R THUMBS>, hold-trigger-on-release;) // Urob's timerless mods
    HOLD_TAP(hrmr, "balanced", 280, (-1), 150, &kp, &kp, <KEYS_L THUMBS>, hold-trigger-on-release;) // Urob's timerless mods
    #define HRML(k1,k2,k3,k4) &hrml LGUI   k1  &hrml LALT  k2  &hrml LCTRL k3  &hrml LSHIFT k4
    #define HRMR(k1,k2,k3,k4) &hrmr RSHIFT k1  &hrmr RCTRL k2  &hrmr RALT  k3  &hrmr RGUI   k4

    HOLD_TAP(callum_mod, "tap-preferred", 180, (-1), (-1), &kp, &sk, <ALL_KEYS>) // Callum Style mods
    #define NK(key) &callum_mod key key


    //NOTE: LAYER SWITCHING
    HOLD_TAP(lt_repeat, "balanced", 200, 175, (-1), &mo, &key_repeat, <ALL_KEYS>) // Layer-Tap + key_repeat
    #define LT_REPEAT(layer) &lt_repeat layer 0

    HOLD_TAP(mo_sl, "tap-preferred", 180, 200, (-1), &mo, &sl, <ALL_KEYS>) // Rafael Romão's sticky layer
    #define MO_SL(layer) &mo_sl layer layer

    HOLD_TAP(mo_bl, "balanced", 180, (-1), 150, &mo, &kp, <ALL_KEYS>)
    TAP_DANCE(blt_dance, 150, <&mo_bl MACRO_LAYER Z>, <&lt BLT Z>)


    //NOTE: MAGIC SHIFT
    STICKY_KEY(sk_quick, &kp, 1000, quick-release;)
    MOD_MORPH(shift_caps, &sk_quick LSHIFT, &caps_word, (MOD_LSFT | MOD_RSFT), 0)
    HOLD_TAP(magic_shift, "balanced", 180, 175, (-1), &kp, &shift_caps, <ALL_KEYS>)
    #define MAGIC_SHIFT &magic_shift LSHFT 0
  };

  // conditional_layers {
  //   compatible = "zmk,conditional-layers";
  //   tri_layer {
  //     if-layers = <NAV SYM_NUM>;
  //     then-layer = <FUNCT>;
  //   };
  // };
};
  
&caps_word {
  /delete-property/ ignore-modifiers;
  continue-list = <UNDERSCORE MINUS BSPC DEL N1 N2 N3 N4 N5 N6 N7 N8 N9 N0>;
};

