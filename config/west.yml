## config/west.yml
```yaml
manifest:
  remotes:
    - name: AndreiDiaconu97
      url-base: https://github.com/AndreiDiaconu97
  projects:
    - name: zmk
      remote: AndreiDiaconu97
      revision: main
      import: app/west.yml
  self:
    path: config
```
